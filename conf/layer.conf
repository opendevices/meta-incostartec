## conf/layer.conf
```bitbake
# We have a conf and classes directory, add to BBPATH
BBPATH .= ":${LAYERDIR}"

# We have recipes-* directories, add to BBFILES
BBFILES += "${LAYERDIR}/recipes-*/*/*.bb \
            ${LAYERDIR}/recipes-*/*/*.bbappend"

BBFILE_COLLECTIONS += "meta-incostartec"
BBFILE_PATTERN_meta-incostartec = "^${LAYERDIR}/"
BBFILE_PRIORITY_meta-incostartec = "11"

LAYERDEPENDS_meta-incostartec = "core"
LAYERSERIES_COMPAT_meta-incostartec = "thud"
```

## conf/machine/plilly-a20.conf
```bitbake
#@TYPE: Machine
#@NAME: pLILLY-A20
#@DESCRIPTION: Machine configuration for the INCOstartec pLILLY-A20

require conf/machine/include/sun7i.inc

MACHINE_EXTRA_RRECOMMENDS = "kernel-modules kernel-devicetree"
PREFERRED_VERSION_linux-mainline = "5.5.3"

DEFAULTTUNE = "cortexa7hf-neon-vfpv4"

KERNEL_DEVICETREE = "sun7i-a20-plilly.dtb"
UBOOT_MACHINE = "plilly-a20_config"
SUNXI_FEX_FILE = "sys_config/a20/Bananapi.fex"
```
